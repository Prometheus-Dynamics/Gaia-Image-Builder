// SPDX-License-Identifier: (GPL-2.0+ OR MIT)
// The ZERO 3E with its USB 2.0 OTG port (usb_host0_xhci) as a USB device,
// for the gadget network beside Ethernet. Written, untested on board.
#include "rk3566-radxa-zero-3e.dts"

&usb_host0_xhci {
	dr_mode = "peripheral";
};
