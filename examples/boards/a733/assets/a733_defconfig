## examples/boards/cast-receiver/external/Config.in
```kconfig
source "$BR2_EXTERNAL_CAST_PATH/package/uxplay/Config.in"
source "$BR2_EXTERNAL_CAST_PATH/package/castidle/Config.in"
```

## examples/boards/cm4-cast-receiver/assets/external/Config.in
```kconfig
source "$BR2_EXTERNAL_CM4_CAST_PATH/package/uxplay/Config.in"
source "$BR2_EXTERNAL_CM4_CAST_PATH/package/castidle/Config.in"
```

## examples/boards/cm4-cast-receiver/assets/external/package/castidle/Config.in
```kconfig
config BR2_PACKAGE_CASTIDLE
	bool "castidle"
	depends on BR2_LINUX_KERNEL # the font comes from the kernel tree
	help
	  The cast receiver's idle screen: the receiver's name and IP
	  addresses on the KMS driver's fbdev emulation (/dev/fb0),
	  black while a receiver holds the display.
```

## examples/boards/cm4-cast-receiver/assets/external/package/uxplay/Config.in
```kconfig
config BR2_PACKAGE_UXPLAY
	bool "uxplay"
	depends on BR2_INSTALL_LIBSTDCPP
	depends on BR2_USE_WCHAR # gstreamer1 -> libglib2
	depends on BR2_TOOLCHAIN_HAS_THREADS
	depends on BR2_USE_MMU
	select BR2_PACKAGE_OPENSSL
	select BR2_PACKAGE_LIBPLIST
	select BR2_PACKAGE_DBUS
	select BR2_PACKAGE_AVAHI
	select BR2_PACKAGE_AVAHI_DAEMON
	select BR2_PACKAGE_AVAHI_LIBDNSSD_COMPATIBILITY
	select BR2_PACKAGE_GSTREAMER1
	select BR2_PACKAGE_GST1_PLUGINS_BASE
	select BR2_PACKAGE_GST1_PLUGINS_BASE_PLUGIN_APP
	help
	  AirPlay mirroring and AirPlay audio server, rendering
	  through GStreamer.

	  https://github.com/FDH2/UxPlay
```

## examples/boards/k230d-zero/assets/buildroot/package/k230-vglite/Config.in
```kconfig
config BR2_PACKAGE_K230_VGLITE
	bool "k230-vglite"
	help
	  libvg_lite.so, the user-space library of the K230's VGLite
	  2.5D GPU (/dev/vg_lite), built from the SDK's package/vg_lite
	  sources without its demos. The SDK's BR2_PACKAGE_VG_LITE
	  lists libdrm as a dependency, which Buildroot then builds and
	  installs whether or not it is enabled; the library itself
	  links only libm.
```

## examples/boards/rock-5c/assets/rock5c_defconfig
```kconfig
# Radxa ROCK 5C (RK3588S2), from Buildroot's rock5b_defconfig: mainline
# U-Boot, TF-A and Linux, with rkbin's DDR init. Written, untested on board.
BR2_aarch64=y
BR2_cortex_a76_a55=y
BR2_DOWNLOAD_FORCE_CHECK_HASHES=y
BR2_TARGET_GENERIC_HOSTNAME="rock5c"
BR2_TARGET_GENERIC_ISSUE="Welcome to the ROCK 5C"
BR2_ROOTFS_DEVICE_CREATION_DYNAMIC_MDEV=y
BR2_SYSTEM_DHCP="eth0"
BR2_PACKAGE_DROPBEAR=y
BR2_LINUX_KERNEL=y
BR2_LINUX_KERNEL_LATEST_VERSION=y
BR2_LINUX_KERNEL_USE_ARCH_DEFAULT_CONFIG=y
BR2_LINUX_KERNEL_DTS_SUPPORT=y
BR2_LINUX_KERNEL_INTREE_DTS_NAME="rockchip/rk3588s-rock-5c"
BR2_LINUX_KERNEL_INSTALL_TARGET=y
BR2_LINUX_KERNEL_NEEDS_HOST_OPENSSL=y
BR2_LINUX_KERNEL_NEEDS_HOST_PYTHON3=y
BR2_PACKAGE_LINUX_FIRMWARE=y
BR2_PACKAGE_LINUX_FIRMWARE_RTL_8169=y
BR2_PACKAGE_ROCKCHIP_RKBIN=y
BR2_PACKAGE_ROCKCHIP_RKBIN_TPL_FILENAME="bin/rk35/rk3588_ddr_lp4_2112MHz_lp5_2400MHz_v1.18.bin"
BR2_TARGET_ARM_TRUSTED_FIRMWARE=y
BR2_TARGET_ARM_TRUSTED_FIRMWARE_LATEST_VERSION=y
BR2_TARGET_ARM_TRUSTED_FIRMWARE_PLATFORM="rk3588"
BR2_TARGET_ARM_TRUSTED_FIRMWARE_IMAGES="bl31/bl31.elf"
BR2_TARGET_ROOTFS_EXT2=y
BR2_TARGET_ROOTFS_EXT2_4=y
BR2_TARGET_ROOTFS_EXT2_SIZE="256M"
BR2_TARGET_UBOOT=y
BR2_TARGET_UBOOT_BUILD_SYSTEM_KCONFIG=y
BR2_TARGET_UBOOT_LATEST_VERSION=y
BR2_TARGET_UBOOT_BOARD_DEFCONFIG="rock-5c-rk3588s"
BR2_TARGET_UBOOT_NEEDS_DTC=y
BR2_TARGET_UBOOT_NEEDS_PYLIBFDT=y
BR2_TARGET_UBOOT_NEEDS_PYELFTOOLS=y
BR2_TARGET_UBOOT_NEEDS_OPENSSL=y
BR2_TARGET_UBOOT_NEEDS_GNUTLS=y
BR2_TARGET_UBOOT_NEEDS_UTIL_LINUX=y
BR2_TARGET_UBOOT_NEEDS_ATF_BL31=y
BR2_TARGET_UBOOT_NEEDS_ATF_BL31_ELF=y
BR2_TARGET_UBOOT_NEEDS_ROCKCHIP_RKBIN=y
BR2_PACKAGE_HOST_DTC=y
```
