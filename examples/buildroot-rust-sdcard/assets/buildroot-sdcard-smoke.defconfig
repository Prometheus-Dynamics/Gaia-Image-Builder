## examples/buildroot-rust-sdcard/assets/buildroot-sdcard-smoke.defconfig
```kconfig
BR2_x86_64=y
BR2_x86_x86_64=y
BR2_TOOLCHAIN_EXTERNAL=y
BR2_TOOLCHAIN_EXTERNAL_BOOTLIN=y
BR2_TOOLCHAIN_EXTERNAL_BOOTLIN_X86_64_GLIBC_STABLE=y
BR2_TARGET_ROOTFS_EXT2=y
BR2_TARGET_ROOTFS_EXT2_4=y
BR2_TARGET_ROOTFS_EXT2_SIZE="64M"
```

## examples/buildroot-rust-squashfs/assets/buildroot-squashfs-smoke.defconfig
```kconfig
BR2_x86_64=y
BR2_x86_x86_64=y
BR2_TOOLCHAIN_EXTERNAL=y
BR2_TOOLCHAIN_EXTERNAL_BOOTLIN=y
BR2_TOOLCHAIN_EXTERNAL_BOOTLIN_X86_64_GLIBC_STABLE=y
BR2_TARGET_ROOTFS_SQUASHFS=y
```
